/dts-v1/;
/* Compile/reference fixture only, not a bootable Q60T board description. */
/ {
	model = "Nike-L Build 088 disabled display reference";
	compatible = "samsung,nikel-build088-reference";
	#address-cells = <1>;
	#size-cells = <1>;

	display@5d0000 {
		compatible = "samsung,nikel-drm-hw-preparation";
		reg = <0x005d0000 0x4000>,
		      <0x005d4000 0x4000>,
		      <0x005d8000 0x4000>;
		reg-names = "osdp", "gp", "mixer";
		/* Provider wiring requires verified SDP1804 gate IDs. */
		status = "disabled";
	};
};
